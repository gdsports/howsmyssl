/*
 * Do the equivalent of and send report on serial console.
 *  $ curl https://www.howsmyssl.com/a/check
 *
 * For Arduino boards ESP32, ESP8266 (AXTLS), ESP8266 (BearSSL),
 * MKR WiFi 1010, and Adafruit Feather M0 with ATWINC15000.
 *
 * BearSSL is much better than AXTLS and it is the default for ESP8266.
 * ESP32, BearSSL, and WiFiNINA (ESP32 inside) all have the "Probably OK" rating.
 * AXTLS has the rating "Improvable".
 */

#include <time.h>
#include <ArduinoJson.h>

#if defined(ADAFRUIT_FEATHER_M0)
// This board is similar to the MKR WiFi 1000. Let's assume if the
// board type is Adafruit Feather M0, it has the ATWINC1500 WiFi module.
#define ADAFRUIT_FEATHER_ATWINC1500
#endif

#if defined(ARDUINO_SAMD_MKRWIFI1010) || defined(ARDUINO_AVR_UNO_WIFI_REV2) || defined(ARDUINO_SAMD_NANO_33_IOT)
#include <SPI.h>
#include <WiFiNINA.h>
#define WIFININA
#elif defined(ADAFRUIT_FEATHER_ATWINC1500)
#include <SPI.h>
#include <WiFi101.h>
#define WIFI101
#elif defined(ESP8266)
// In ESP8266 <= 2.4.2 do not define either of the following.
// In ESP8266 >= 2.5 define one or the other but not both.
//#define USING_AXTLS
#define USING_BEARSSL
#include <ESP8266WiFi.h>
#endif

#if defined(ESP8266) && defined(USING_AXTLS)
// force use of AxTLS (BearSSL is now default)
#include <WiFiClientSecureAxTLS.h>
using namespace axTLS;
#elif !defined(WIFININA) && !defined(WIFI101)
#include <WiFiClientSecure.h>
#endif

const char ssid[]     = "SSID";
const char password[] = "PASSWORD";
#define server          "www.howsmyssl.com"
#define url_path        "/a/check"
#define JSON_BUFFER 8192

#if defined(ESP8266)
#if defined(USING_AXTLS)
const char TLS_STACK[] = "ESP8266 AXTLS";
#elif defined(USING_BEARSSL)
const char TLS_STACK[] = "ESP8266 BearSSL";
#endif
#elif defined(ESP32)
const char TLS_STACK[] = "ESP32 TLS";
#elif defined(WIFININA)
const char TLS_STACK[] = "WiFiNINA";
#elif defined(WIFI101)
const char TLS_STACK[] = "WiFi101";
#else
#error "Board not supported"
#endif

// www.howsmyssl.com root certificate authority, to verify the server
// change it to your server root CA
// SHA1 fingerprint is broken now!
//
#if defined(ESP32) || defined(USING_BEARSSL)
const char DST_ROOT_CA_X3[] PROGMEM = R"====(
-----BEGIN CERTIFICATE-----
MIIDSjCCAjKgAwIBAgIQRK+wgNajJ7qJMDmGLvhAazANBgkqhkiG9w0BAQUFADA/
MSQwIgYDVQQKExtEaWdpdGFsIFNpZ25hdHVyZSBUcnVzdCBDby4xFzAVBgNVBAMT
DkRTVCBSb290IENBIFgzMB4XDTAwMDkzMDIxMTIxOVoXDTIxMDkzMDE0MDExNVow
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Ob8VZRzI9neWagqNdwvYkQsEjgfbKbYK7p2CNTUQ
-----END CERTIFICATE-----
)====";

#elif defined(ESP8266)
// Same as above but in binary DER format
unsigned char DST_Root_CA_X3_der[] PROGMEM = {
  0x30, 0x82, 0x03, 0x4a, 0x30, 0x82, 0x02, 0x32, 0xa0, 0x03, 0x02, 0x01,
  0x02, 0x02, 0x10, 0x44, 0xaf, 0xb0, 0x80, 0xd6, 0xa3, 0x27, 0xba, 0x89,
  0x30, 0x39, 0x86, 0x2e, 0xf8, 0x40, 0x6b, 0x30, 0x0d, 0x06, 0x09, 0x2a,
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  0xee, 0x9d, 0x82, 0x35, 0x35, 0x10
};
unsigned int DST_Root_CA_X3_der_len = 846;
#endif

#if defined(ESP32) || defined(ESP8266)
// Set time via NTP, as required for x.509 validation
void setClock() {
  configTime(3 * 3600, 0, "pool.ntp.org", "time.nist.gov");

  Serial.print("Waiting for NTP time sync: ");
  time_t now = time(nullptr);
  while (now < 8 * 3600 * 2) {
    delay(500);
    Serial.print(".");
    now = time(nullptr);
  }
  Serial.println("");
  struct tm timeinfo;
  gmtime_r(&now, &timeinfo);
  Serial.print("Current time: ");
  Serial.print(asctime(&timeinfo));
}
#endif

void howsmyssl()
{
#if defined(WIFININA) || defined(WIFI101)
WiFiSSLClient client;
#elif defined(ESP8266)
#if defined(USING_AXTLS)
#pragma GCC diagnostic push
#pragma GCC diagnostic ignored  "-Wdeprecated-declarations"
  WiFiClientSecure client;
#pragma GCC diagnostic pop
  client.setCACert_P(DST_Root_CA_X3_der, DST_Root_CA_X3_der_len);
#elif defined(USING_BEARSSL)
  BearSSL::WiFiClientSecure client;
  BearSSL::X509List cert(DST_ROOT_CA_X3);
  client.setTrustAnchors(&cert);
#endif
#else
  // ESP32
  WiFiClientSecure client;
  client.setCACert(DST_ROOT_CA_X3);
#endif

  client.setTimeout(10000);

  Serial.println("\nStarting connection to server...");
  if (!client.connect(server, 443))
    Serial.println("Connection failed!");
  else {
    Serial.println("Connected to server!");
#if defined(ESP8266) && defined(USING_AXTLS)
    // Verify validity of server's certificate
    if (client.verifyCertChain(server)) {
      Serial.println("Server certificate verified");
    } else {
      Serial.println("ERROR: certificate verification failed!");
      return;
    }
#endif

    client.print("GET " url_path " HTTP/1.1\r\n" \
               "Host: " server "\r\n" \
               "User-Agent: arduino/1.0.0\r\n" \
               "Connection: close\r\n\r\n");

    Serial.println("request sent");
    // Check HTTP status
    char status[32] = {0};
    client.readBytesUntil('\r', status, sizeof(status));
    Serial.println(status);
    // It should be "HTTP/1.0 200 OK" or "HTTP/1.1 200 OK"
    if (strcmp(status + 9, "200 OK") != 0) {
      Serial.print(F("Unexpected response: "));
      Serial.println(status);
      return;
    }

    // Skip HTTP headers
    char endOfHeaders[] = "\r\n\r\n";
    if (!client.find(endOfHeaders)) {
      Serial.println(F("Invalid response"));
      return;
    }

    const size_t capacity = JSON_ARRAY_SIZE(4) + JSON_OBJECT_SIZE(0) + JSON_OBJECT_SIZE(10) + JSON_BUFFER;
    DynamicJsonDocument doc(capacity);

    // Parse JSON object
    DeserializationError error = deserializeJson(doc, client);
    if (error) {
      Serial.print("deserializeJson() failed: ");
      Serial.println(error.c_str());
      return;
    }
    bool ephemeral_keys_supported = doc["ephemeral_keys_supported"]; // false
    bool session_ticket_supported = doc["session_ticket_supported"]; // false
    bool tls_compression_supported = doc["tls_compression_supported"]; // false
    bool unknown_cipher_suite_supported = doc["unknown_cipher_suite_supported"]; // false
    bool beast_vuln = doc["beast_vuln"]; // false
    bool able_to_detect_n_minus_one_splitting = doc["able_to_detect_n_minus_one_splitting"]; // false
    const char* tls_version = doc["tls_version"];
    const char* rating = doc["rating"];

    Serial.println();
    Serial.println(TLS_STACK);
    Serial.print("TLS protocol: ");
    Serial.println(tls_version);
    Serial.print("Rating: ");
    Serial.println(rating);
    Serial.print("Ephemeral keys supported: ");
    Serial.println(ephemeral_keys_supported);
    Serial.print("Session ticket supported: ");
    Serial.println(session_ticket_supported);
    Serial.print("TLS compression supported: ");
    Serial.println(tls_compression_supported);
    Serial.print("Unknown cipher suite supported: ");
    Serial.println(unknown_cipher_suite_supported);
    Serial.print("Beast vuln: ");
    Serial.println(beast_vuln);
    Serial.print("Able to detect n minus one splitting: ");
    Serial.println(able_to_detect_n_minus_one_splitting);

    Serial.println();
    JsonArray given_cipher_suites = doc["given_cipher_suites"];
    if (given_cipher_suites.isNull()) {
      Serial.println("No cipher suites");
    }
    else {
      Serial.println("Cipher Suites:");
      const char *cipher_suite;
      for (int i = 0; ; i++) {
        cipher_suite = given_cipher_suites[i];
        if (cipher_suite == NULL) break;
        Serial.print('\t');
        Serial.println(cipher_suite);
      }
    }

    client.stop();
  }
}

void printWiFiStatus() {
  // print the SSID of the network you're attached to:
  Serial.print("SSID: ");
  Serial.println(WiFi.SSID());

  // print your board's IP address:
  IPAddress ip = WiFi.localIP();
  Serial.print("IP Address: ");
  Serial.println(ip);

  // print the received signal strength:
  long rssi = WiFi.RSSI();
  Serial.print("signal strength (RSSI):");
  Serial.print(rssi);
  Serial.println(" dBm");
}

void setup() {
#if defined(ADAFRUIT_FEATHER_ATWINC1500)
  //Configure pins for Adafruit ATWINC1500 Feather
  WiFi.setPins(8,7,4,2);
#endif
  //Initialize serial and wait for port to open:
  Serial.begin(115200);
#if defined(USBCON)
  while (!Serial) delay(1);
#endif
  delay(100);
  Serial.println();

#if defined(WIFININA)
  // check for the WiFi module:
  if (WiFi.status() == WL_NO_MODULE) {
    Serial.println("Communication with WiFiNINA module failed!");
    // don't continue
    while (true);
  }
#elif defined(WIFI101)
  // check for the WiFi module:
  if (WiFi.status() == WL_NO_SHIELD) {
    Serial.println("Communication with WiFi101 module failed!");
    // don't continue
    while (true);
  }
#endif

#if defined(WIFININA) || defined(WIFI101)
  String fv = WiFi.firmwareVersion();
  Serial.print("WiFiNINA/WiFi101 f/w version: ");
  Serial.println(fv);
  if (fv < "1.0.0") {
    Serial.println("Please upgrade the firmware");
  }
#endif

  // attempt to connect to WiFi network:

  Serial.print("Attempting to connect to SSID: ");
  Serial.println(ssid);
#if defined(ESP8266) || defined(ESP32)
  WiFi.mode(WIFI_STA);
#endif
  WiFi.begin(ssid, password);

  // attempt to connect to Wifi network:
  while (WiFi.status() != WL_CONNECTED) {
    Serial.print('.');
    // wait 1 second for re-trying
    delay(1000);
  }

  Serial.print("Connected to ");
  Serial.println(ssid);
  printWiFiStatus();

#if defined(ESP8266) || defined(ESP32)
  setClock();
#endif

  howsmyssl();
}

void loop() {
  // do nothing
}
