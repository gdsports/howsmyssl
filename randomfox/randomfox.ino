/*
 * Do the equivalent of and send report on serial console.
 *  $ curl https://www.howsmyssl.com/a/check
 *
 * For Arduino boards ESP32, ESP8266 (AXTLS), ESP8266 (BearSSL),
 * MKR WiFi 1010, and Adafruit Feather M0 with ATWINC15000.
 *
 * BearSSL is much better than AXTLS and it is the default for ESP8266.
 * ESP32, BearSSL, and WiFiNINA (ESP32 inside) all have the "Probably OK" rating.
 * AXTLS has the rating "Improvable".
 */

#include <time.h>
#include <ArduinoJson.h>

#if defined(ADAFRUIT_FEATHER_M0)
// This board is similar to the MKR WiFi 1000. Let's assume if the
// board type is Adafruit Feather M0, it has the ATWINC1500 WiFi module.
#define ADAFRUIT_FEATHER_ATWINC1500
#endif

#if defined(ARDUINO_SAMD_MKRWIFI1010) || defined(ARDUINO_AVR_UNO_WIFI_REV2) || defined(ARDUINO_SAMD_NANO_33_IOT)
#include <SPI.h>
#include <WiFiNINA.h>
#define WIFININA
#elif defined(ADAFRUIT_FEATHER_ATWINC1500)
#include <SPI.h>
#include <WiFi101.h>
#define WIFI101
#elif defined(ESP8266)
// In ESP8266 <= 2.4.2 do not define either of the following.
// In ESP8266 >= 2.5 define one or the other but not both.
//#define USING_AXTLS
#define USING_BEARSSL
#include <ESP8266WiFi.h>
#endif

#if defined(ESP8266) && defined(USING_AXTLS)
// force use of AxTLS (BearSSL is now default)
#include <WiFiClientSecureAxTLS.h>
using namespace axTLS;
#elif !defined(WIFININA) && !defined(WIFI101)
#include <WiFiClientSecure.h>
#endif

const char ssid[]     = "kiddeice";
const char password[] = "aZoE9b83LhipgXw";
#define server "randomfox.ca"
#define url_path "/floof/"
#define JSON_BUFFER (512)

#if defined(ESP8266)
#if defined(USING_AXTLS)
const char TLS_STACK[] = "ESP8266 AXTLS";
#elif defined(USING_BEARSSL)
const char TLS_STACK[] = "ESP8266 BearSSL";
#endif
#elif defined(ESP32)
const char TLS_STACK[] = "ESP32 TLS";
#elif defined(WIFININA)
const char TLS_STACK[] = "WiFiNINA";
#elif defined(WIFI101)
const char TLS_STACK[] = "WiFi101";
#else
#error "Board not supported"
#endif

// api.weather.gov root certificate authority, to verify the server
// change it to your server root CA
// SHA1 fingerprint is broken now!
//
#if defined(ESP32) || defined(USING_BEARSSL)
const char COMODOECCCertificationAuthority[] PROGMEM = R"====(
-----BEGIN CERTIFICATE-----
MIICiTCCAg+gAwIBAgIQH0evqmIAcFBUTAGem2OZKjAKBggqhkjOPQQDAzCBhTEL
MAkGA1UEBhMCR0IxGzAZBgNVBAgTEkdyZWF0ZXIgTWFuY2hlc3RlcjEQMA4GA1UE
BxMHU2FsZm9yZDEaMBgGA1UEChMRQ09NT0RPIENBIExpbWl0ZWQxKzApBgNVBAMT
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GDeAU/7dIOA1mjbRxwG55tzd8/8dLDoWV9mSOdY=
-----END CERTIFICATE-----
)====";

#elif defined(ESP8266)
// Same as above but in binary DER format
const unsigned char COMODOECCCertificationAuthority_der PROGMEM [] = {
  0x30, 0xc2, 0x82, 0x02, 0xc2, 0x89, 0x30, 0xc2, 0x82, 0x02, 0x0f, 0xc2,
  0xa0, 0x03, 0x02, 0x01, 0x02, 0x02, 0x10, 0x1f, 0x47, 0xc2, 0xaf, 0xc2,
  0xaa, 0x62, 0x00, 0x70, 0x50, 0x54, 0x4c, 0x01, 0xc2, 0x9e, 0xc2, 0x9b,
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  0xc3, 0x99, 0xc2, 0x92, 0x39, 0xc3, 0x96
};
const unsigned int COMODOECCCertificationAuthority_der_len = 775;
#endif

#if defined(ESP32) || defined(ESP8266)
// Set time via NTP, as required for x.509 validation
void setClock() {
  configTime(3 * 3600, 0, "pool.ntp.org", "time.nist.gov");

  Serial.print("Waiting for NTP time sync: ");
  time_t now = time(nullptr);
  while (now < 8 * 3600 * 2) {
    delay(500);
    Serial.print(".");
    now = time(nullptr);
  }
  Serial.println("");
  struct tm timeinfo;
  gmtime_r(&now, &timeinfo);
  Serial.print("Current time: ");
  Serial.print(asctime(&timeinfo));
}
#endif

void weathergov()
{
#if defined(WIFININA) || defined(WIFI101)
WiFiSSLClient client;
#elif defined(ESP8266)
#if defined(USING_AXTLS)
#pragma GCC diagnostic push
#pragma GCC diagnostic ignored  "-Wdeprecated-declarations"
  WiFiClientSecure client;
#pragma GCC diagnostic pop
  client.setCACert_P(COMODOECCCertificationAuthority_der,
      COMODOECCCertificationAuthority_der_len);
#elif defined(USING_BEARSSL)
  BearSSL::WiFiClientSecure client;
  BearSSL::X509List cert(COMODOECCCertificationAuthority);
  client.setTrustAnchors(&cert);
#endif
#else
  // ESP32
  WiFiClientSecure client;
  client.setCACert(COMODOECCCertificationAuthority);
#endif

  client.setTimeout(10000);

  Serial.println("\nStarting connection to server...");
  if (!client.connect(server, 443))
    Serial.println("Connection failed!");
  else {
    Serial.println("Connected to server!");
#if defined(ESP8266) && defined(USING_AXTLS)
    // Verify validity of server's certificate
    if (client.verifyCertChain(server)) {
      Serial.println("Server certificate verified");
    } else {
      Serial.println("ERROR: certificate verification failed!");
      return;
    }
#endif

    client.print("GET " url_path " HTTP/1.1\r\n" \
               "Host: " server "\r\n" \
               "User-Agent: arduino/1.0.0\r\n" \
               "Connection: close\r\n\r\n");

    Serial.println("request sent");
    // Check HTTP status
    char status[32] = {0};
    client.readBytesUntil('\r', status, sizeof(status));
    Serial.println(status);
    // It should be "HTTP/1.0 200 OK" or "HTTP/1.1 200 OK"
    if (strcmp(status + 9, "200 OK") != 0) {
      Serial.print(F("Unexpected response: "));
      Serial.println(status);
      return;
    }

    // Skip HTTP headers
    char endOfHeaders[] = "\r\n\r\n";
    if (!client.find(endOfHeaders)) {
      Serial.println(F("Invalid response"));
      return;
    }

    // Transfer-Encoding: chunked
    // Skip next line which has the length of the next chunk
    client.readBytesUntil('\r', status, sizeof(status));

    const size_t capacity = JSON_OBJECT_SIZE(2) + JSON_BUFFER;
    DynamicJsonDocument doc(capacity);

    // Parse JSON object
    DeserializationError error = deserializeJson(doc, client);
    if (error) {
      Serial.print("deserializeJson() failed: ");
      Serial.println(error.c_str());
      return;
    }
    const char* image = doc["image"]; // "http://randomfox.ca/images/31.jpg"
    const char* link = doc["link"]; // "http://randomfox.ca/?i=31"
    if (image) {
      Serial.print("image: ");
      Serial.println(image);
    }
    if (link) {
      Serial.print("link: ");
      Serial.println(link);
    }

    client.stop();
  }
}

void printWiFiStatus() {
  // print the SSID of the network you're attached to:
  Serial.print("SSID: ");
  Serial.println(WiFi.SSID());

  // print your board's IP address:
  IPAddress ip = WiFi.localIP();
  Serial.print("IP Address: ");
  Serial.println(ip);

  // print the received signal strength:
  long rssi = WiFi.RSSI();
  Serial.print("signal strength (RSSI):");
  Serial.print(rssi);
  Serial.println(" dBm");
}

void setup() {
#if defined(ADAFRUIT_FEATHER_ATWINC1500)
  //Configure pins for Adafruit ATWINC1500 Feather
  WiFi.setPins(8,7,4,2);
#endif
  //Initialize serial and wait for port to open:
  Serial.begin(115200);
#if defined(USBCON)
  while (!Serial) delay(1);
#endif
  delay(100);
  Serial.println();
  Serial.print("TLS Stack:");
  Serial.println(TLS_STACK);

#if defined(WIFININA)
  // check for the WiFi module:
  if (WiFi.status() == WL_NO_MODULE) {
    Serial.println("Communication with WiFiNINA module failed!");
    // don't continue
    while (true);
  }
#elif defined(WIFI101)
  // check for the WiFi module:
  if (WiFi.status() == WL_NO_SHIELD) {
    Serial.println("Communication with WiFi101 module failed!");
    // don't continue
    while (true);
  }
#endif

#if defined(WIFININA) || defined(WIFI101)
  String fv = WiFi.firmwareVersion();
  Serial.print("WiFiNINA/WiFi101 f/w version: ");
  Serial.println(fv);
  if (fv < "1.0.0") {
    Serial.println("Please upgrade the firmware");
  }
#endif

  // attempt to connect to WiFi network:

  Serial.print("Attempting to connect to SSID: ");
  Serial.println(ssid);
#if defined(ESP8266) || defined(ESP32)
  WiFi.mode(WIFI_STA);
#endif
  WiFi.begin(ssid, password);

  // attempt to connect to Wifi network:
  while (WiFi.status() != WL_CONNECTED) {
    Serial.print('.');
    // wait 1 second for re-trying
    delay(1000);
  }

  Serial.print("Connected to ");
  Serial.println(ssid);
  printWiFiStatus();

#if defined(ESP8266) || defined(ESP32)
  setClock();
#endif

  weathergov();
}

void loop() {
  // do nothing
}
